## firmware/main/Kconfig.projbuild
```kconfig
menu "Desk Hub"

    config HUB_WIFI_SSID
        string "Wi-Fi SSID (2.4 GHz)"
        default ""

    config HUB_WIFI_PASSWORD
        string "Wi-Fi password"
        default ""

    config HUB_TOKEN
        string "Companion token"
        default "change-me"
        help
            Shared secret. Put the same value in the companion's config.toml.

    config HUB_HOSTNAME
        string "mDNS hostname"
        default "deskhub"
        help
            The hub answers at <hostname>.local on your network.

    config HUB_TZ
        string "POSIX time zone"
        default "EST5EDT,M3.2.0,M11.1.0"
        help
            Examples: PST8PDT,M3.2.0,M11.1.0 / CST6CDT,M3.2.0,M11.1.0 /
            GMT0BST,M3.5.0/1,M10.5.0 / CET-1CEST,M3.5.0,M10.5.0/3

    config HUB_CITY
        string "City name shown on the weather page"
        default "New York"

    config HUB_LATITUDE
        string "Latitude"
        default "40.7128"

    config HUB_LONGITUDE
        string "Longitude"
        default "-74.0060"

    config HUB_FAHRENHEIT
        bool "Use Fahrenheit and mph"
        default y

    config HUB_24H
        bool "24-hour clock"
        default n

    config HUB_SCREEN_OFF_MIN
        int "Turn the screen off after this many idle minutes (0 = never)"
        default 0
        range 0 240
        help
            Any touch, or new media starting, turns it back on.

    config HUB_ROTATION_270
        bool "Turn the picture the other way round (ESP32-P4 board)"
        depends on IDF_TARGET_ESP32P4
        default n
        help
            The ESP32-P4 board's panel is portrait and the dashboard is turned
            90 degrees onto it. Set this if the picture is upside down.
            Touch follows the picture.

    config HUB_TOUCH_ROTATE_180
        bool "Turn touch input 180 degrees (ESP32-P4 board)"
        depends on IDF_TARGET_ESP32P4
        default n
        help
            Set this only if taps land on the opposite corner of the screen
            while the picture is the right way up.

endmenu

# esp_hosted 3.x gates optional USB dependencies on these options. The solver
# reads those rules before settling on the pinned esp_hosted 1.4.x, which does
# not define them, and configure then fails with "Missing required kconfig
# option". Defining them here (0) lets the rules evaluate to false. They need a
# prompt: Kconfig leaves hidden symbols out of sdkconfig.
menu "Desk Hub: ESP32-P4 Wi-Fi build fix"
    depends on IDF_TARGET_ESP32P4
    config ESP_HOSTED_HOST_USB_CDC_ACM_MANIFEST
        int "Leave at 0 (esp_hosted USB CDC-ACM)"
        default 0
    config ESP_HOSTED_HOST_USB_CHERRYUSB_MANIFEST
        int "Leave at 0 (esp_hosted CherryUSB)"
        default 0
    config ESP_HOSTED_HOST_USB_RNDIS_MANIFEST
        int "Leave at 0 (esp_hosted USB RNDIS)"
        default 0
endmenu
```
